# file: RHF76-052.ioc
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Mcu.Family=STM32L0
Mcu.Name=STM32L051C(6-8)Tx
Mcu.Package=LQFP48
ProjectManager.HeapSize=0x200
ProjectManager.StackSize=0x400
ProjectManager.TargetToolchain=STM32CubeIDE
RCC.AHBFreq_Value=2097000
RCC.APB1Freq_Value=2097000
RCC.APB1TimFreq_Value=2097000
RCC.APB2Freq_Value=2097000
RCC.APB2TimFreq_Value=2097000
RCC.HSE_VALUE=8000000
RCC.HSI16_VALUE=16000000
RCC.HSI_VALUE=16000000
RCC.LSE_VALUE=32768
RCC.MSI_VALUE=2097000
RCC.SYSCLKFreq_VALUE=2097000
RCC.VCOOutputFreq_Value=48000000
board=custom

// file: Core/Src/main.c
/* USER CODE BEGIN Header */
/**
  ******************************************************************************
  * @file           : main.c
  * @brief          : Main program body
  ******************************************************************************
  * @attention
  *
  * <h2><center>&copy; Copyright (c) 2020 STMicroelectronics.
  * All rights reserved.</center></h2>
  *
  * This software component is licensed by ST under BSD 3-Clause license,
  * the "License"; You may not use this file except in compliance with the
  * License. You may obtain a copy of the License at:
  *                        opensource.org/licenses/BSD-3-Clause
  *
  ******************************************************************************
  */
/* USER CODE END Header */

/* USER CODE BEGIN Includes */
#include "main.h"
#include "stdio.h"
/* USER CODE END Includes */

/* USER CODE BEGIN PTD */
extern uint8_t rssi,snr;
/* USER CODE END PTD */

/* USER CODE BEGIN PV */

uint8_t isDIO_0_Flag = 0;

/* USER CODE END PV */

void SystemClock_Config(void);

int main(void)
{
  /* USER CODE BEGIN 1 */
	uint8_t LTX_BUF[255]="4321";
	uint8_t LRX_BUF[255]={0};
	uint8_t LTX_BUF_SIZE = 4;
	uint8_t LRX_BUF_SIZE = 0;

	uint8_t isReceived = 0;
  /* USER CODE END 1 */

  /* MCU Configuration--------------------------------------------------------*/

  /* Reset of all peripherals, Initializes the Flash interface and the Systick. */

  /* Configure the system clock */

  /* USER CODE BEGIN SysInit */
	clockInit();
  /* USER CODE END SysInit */

  /* Initialize all configured peripherals */
  /* USER CODE BEGIN 2 */
	initSPI1();
	SX1276Init();
	SX1276_Init();
	initUsart1();

	setRFSwitch(0);
	Delay(0xFFFFF);
	SX1276_SendTXBUF(LTX_BUF, LTX_BUF_SIZE);
	SX1276_CleanBuffer();

	setRFSwitch(1);

	char strCheck[256];

	/* USER CODE END 2 */

  /* Infinite loop */
  /* USER CODE BEGIN WHILE */

  while (1)
  {
#if RECEIVER == 1
	  if(isDIO_0_Flag)
	  {
		  isReceived = SX1276_ReadRXBUF(LRX_BUF, &LRX_BUF_SIZE);
		  if(isReceived)
		  {
			  int RSSI = -164 + rssi; //+ (snr >> 2);
			  setRFSwitch(0);
			  SX1276_SendTXBUF(LTX_BUF, LTX_BUF_SIZE);
			  SX1276_CleanBuffer();
			  isReceived = 0;
			  setRFSwitch(1);
			  sprintf(strCheck,"\nMessage: %s, RSSI: %d", LTX_BUF, RSSI);
			  sendStringUsart1(strCheck);
		  }
		  isDIO_0_Flag = 0;
  	  }
#else
	  //only send
	  Delay(0x3FFFFF);
	  SX1276_SendTXBUF(LTX_BUF, LTX_BUF_SIZE);
	  SX1276_CleanBuffer();
#endif
    /* USER CODE END WHILE */

  }
}

/* USER CODE BEGIN 4 */

//interrupt from DIO0 SX1276 on PB10
void EXTI4_15_IRQHandler(void){

	isDIO_0_Flag = 1;
	EXTI->PR |= EXTI_PR_PR10;

}

void setRFSwitch(uint8_t isReceiver){

	if(isReceiver)
	{
		GPIOA->ODR |= GPIO_ODR_OD1;
		GPIOA->ODR |= GPIO_ODR_OD2;
	}
	else
	{
		GPIOA->ODR &= ~GPIO_ODR_OD1;
		GPIOA->ODR &= ~GPIO_ODR_OD2;
	}
}
/* USER CODE END 4 */

void Error_Handler(void)
{
}

/************************ (C) COPYRIGHT STMicroelectronics *****END OF FILE****/
